## config/west.yml
```yaml
manifest:
  remotes:
    - name: zmkfirmware 
      url-base: https://github.com/zmkfirmware
    - name: MeowCatpawkittie
      url-base: https://github.com/MeowCatpawkittie 
    - name: sekigon-gonnoc
      url-base: https://github.com/sekigon-gonnoc
  projects:
    - name: zmk
      remote: zmkfirmware
      revision: v0.3
      import: app/west.yml
    - name: zmk-driver-paw3222
      remote: sekigon-gonnoc
      revision: main
    - name: zmk-rgbled-widget
      url: https://github.com/caksoylar/zmk-rgbled-widget
      revision: v0.3  
  self:
    path: config
```
